## m5_sticks3/components/connectivity/Kconfig.projbuild
```kconfig
menu "M5-StickS3 connectivity"
    config M5_CONNECTIVITY_CONSOLE_ENABLED
        bool "Enable local radio commands over USB Serial/JTAG console"
        depends on ESP_CONSOLE_USB_SERIAL_JTAG
        default y
        help
            Local CLI and API v1 JSON line input. Physical USB requests do not
            require the radio API token. No command echo or password history.
            Paused while USB CMSIS-DAP owns the internal PHY.
    config M5_CONNECTIVITY_WIFI_ENABLED
        bool "Enable Wi-Fi AP/STA and local HTTP API"
        select HTTPD_WS_SUPPORT
        select HTTPD_WS_PRE_HANDSHAKE_CB_SUPPORT
        default y
    config M5_CONNECTIVITY_BLE_ENABLED
        bool "Enable NimBLE GATT transport"
        depends on BT_NIMBLE_ENABLED
        default y
endmenu

config M5_CONNECTIVITY_LOG_SECRETS
    bool "Log legacy credentials on physical USB (development only)"
    default n
```
