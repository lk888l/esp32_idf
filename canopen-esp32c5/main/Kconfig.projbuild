## canopen-esp32c5/main/Kconfig.projbuild
```kconfig
menu "CANopen ESP32-C5"

config CANOPEN_NODE_ID
    int "CANopen node ID"
    range 1 127
    default 33

config CANOPEN_HEARTBEAT_PERIOD_MS
    int "Default producer heartbeat period (ms)"
    range 1 65535
    default 100

config CANOPEN_TWAI_TX_GPIO
    int "TWAI-FD TX GPIO"
    range 0 30
    default 4

config CANOPEN_TWAI_RX_GPIO
    int "TWAI-FD RX GPIO"
    range 0 30
    default 5

config CANOPEN_TWAI_TX_QUEUE_DEPTH
    int "TWAI driver TX queue depth"
    range 4 64
    default 16

config CANOPEN_TWAI_RX_QUEUE_DEPTH
    int "Application RX queue depth"
    range 8 128
    default 32

config CANOPEN_GATEWAY_INGRESS_QUEUE_DEPTH
    int "Wireless-to-CAN ingress queue depth"
    range 8 128
    default 32

config CANOPEN_GATEWAY_MONITOR_QUEUE_DEPTH
    int "CAN-to-wireless monitor queue depth"
    range 16 128
    default 64

config CANOPEN_TASK_STACK_SIZE
    int "CANopen service task stack size"
    range 4096 16384
    default 6144

config CANOPEN_TASK_PRIORITY
    int "CANopen service task priority"
    range 2 20
    default 12

config CANOPEN_VENDOR_ID
    hex "Identity vendor ID (0x1018:01)"
    default 0x00000000

config CANOPEN_PRODUCT_CODE
    hex "Identity product code (0x1018:02)"
    default 0xC5000001

config CANOPEN_REVISION_NUMBER
    hex "Identity revision number (0x1018:03)"
    default 0x00010000

config CANOPEN_SERIAL_NUMBER
    hex "Identity serial number (0x1018:04)"
    default 0x00000001

endmenu

menu "Wireless CAN-FD gateway"

config WIRELESS_GATEWAY_ENABLED
    bool "Enable BLE and Wi-Fi CAN-FD gateway"
    depends on BT_ENABLED && BT_NIMBLE_ENABLED
    default n
    help
        Fail-closed by default. Enable only after supplying all three secrets
        below from a protected sdkconfig overlay or CI secret store.

config WIRELESS_AP_PASSWORD
    string "SoftAP WPA2/WPA3 password"
    depends on WIRELESS_GATEWAY_ENABLED
    default ""
    help
        Must contain 8 to 63 characters. It is never logged or returned over
        any wireless interface.

config WIRELESS_BLE_PASSKEY
    int "BLE Secure Connections passkey"
    depends on WIRELESS_GATEWAY_ENABLED
    range 0 999999
    default 0
    help
        Set a six-digit value from 100000 to 999999. The client enters it
        during MITM-protected pairing.

config WIRELESS_TCP_CONTROL_KEY_HEX
    string "TCP HMAC-SHA256 control key (64 hex digits)"
    depends on WIRELESS_GATEWAY_ENABLED
    default ""
    help
        A non-zero 32-byte key used by the TCP challenge-response handshake.
        Inject it through a protected build configuration; it is never logged
        or returned over the air.

config WIRELESS_AP_CHANNEL
    int "SoftAP channel"
    depends on WIRELESS_GATEWAY_ENABLED
    range 1 13
    default 6

config WIRELESS_AP_MAX_CLIENTS
    int "Maximum SoftAP clients"
    depends on WIRELESS_GATEWAY_ENABLED
    range 1 8
    default 4

config WIRELESS_TCP_PORT
    int "CAN-FD tunnel TCP port"
    depends on WIRELESS_GATEWAY_ENABLED
    range 1024 65535
    default 3333

config WIRELESS_DISCOVERY_PORT
    int "UDP discovery port"
    depends on WIRELESS_GATEWAY_ENABLED
    range 1024 65535
    default 3334

config WIRELESS_TCP_MAX_CLIENTS
    int "Maximum authenticated TCP clients"
    depends on WIRELESS_GATEWAY_ENABLED
    range 1 4
    default 2

config WIRELESS_TCP_TASK_STACK_SIZE
    int "TCP server task stack size"
    depends on WIRELESS_GATEWAY_ENABLED
    range 4096 12288
    default 6144

config WIRELESS_TCP_TASK_PRIORITY
    int "TCP server task priority"
    depends on WIRELESS_GATEWAY_ENABLED
    range 2 15
    default 8

config WIRELESS_SERVICE_TASK_STACK_SIZE
    int "Wireless router task stack size"
    depends on WIRELESS_GATEWAY_ENABLED
    range 4096 12288
    default 6144

config WIRELESS_SERVICE_TASK_PRIORITY
    int "Wireless router task priority"
    depends on WIRELESS_GATEWAY_ENABLED
    range 2 15
    default 9

endmenu
```

## canopen-esp32c5/sdkconfig.defaults
```kconfig
CONFIG_IDF_TARGET="esp32c5"
CONFIG_IDF_TARGET_ESP32C5=y
CONFIG_ESP_MAIN_TASK_STACK_SIZE=8192
CONFIG_FREERTOS_HZ=1000
CONFIG_COMPILER_CXX_EXCEPTIONS=n
CONFIG_COMPILER_CXX_RTTI=n
CONFIG_LOG_DEFAULT_LEVEL_INFO=y
CONFIG_ESP_CONSOLE_USB_SERIAL_JTAG=y
CONFIG_PARTITION_TABLE_SINGLE_APP_LARGE=y

CONFIG_BT_ENABLED=y
CONFIG_BT_NIMBLE_ENABLED=y
CONFIG_BT_NIMBLE_ROLE_PERIPHERAL=y
CONFIG_BT_NIMBLE_MAX_CONNECTIONS=1
CONFIG_BT_NIMBLE_ATT_PREFERRED_MTU=247
CONFIG_BT_NIMBLE_STATIC_PASSKEY=y
```

## esp-idf-icm42688/sdkconfig.defaults
```kconfig
CONFIG_IDF_TARGET="esp32c5"
CONFIG_IDF_TARGET_ESP32C5=y
CONFIG_ESP_MAIN_TASK_STACK_SIZE=8192
CONFIG_FREERTOS_HZ=1000
```

## esp32_s3_camera_webserver/main/Kconfig.projbuild
```kconfig
menu "Camera Web Server"

config CAMERA_WEB_WIFI_SSID
    string "Wi-Fi SSID"
    default "YOUR_WIFI_SSID"
    help
        Wi-Fi network name used by the camera web server.

config CAMERA_WEB_WIFI_PASSWORD
    string "Wi-Fi password"
    default "YOUR_WIFI_PASSWORD"
    help
        Wi-Fi password used by the camera web server.

config CAMERA_WEB_WIFI_MAXIMUM_RETRY
    int "Wi-Fi maximum retry count"
    default 8
    range 1 30

config CAMERA_WEB_WIFI_CONNECT_TIMEOUT_MS
    int "Wi-Fi connect timeout in milliseconds"
    default 20000
    range 1000 120000

choice CAMERA_WEB_FRAMESIZE
    prompt "Camera frame size"
    default CAMERA_WEB_FRAMESIZE_QSXGA

config CAMERA_WEB_FRAMESIZE_QVGA
    bool "QVGA 320x240"

config CAMERA_WEB_FRAMESIZE_VGA
    bool "VGA 640x480"

config CAMERA_WEB_FRAMESIZE_SVGA
    bool "SVGA 800x600"

config CAMERA_WEB_FRAMESIZE_XGA
    bool "XGA 1024x768"

config CAMERA_WEB_FRAMESIZE_SXGA
    bool "SXGA 1280x1024"

config CAMERA_WEB_FRAMESIZE_UXGA
    bool "UXGA 1600x1200"

config CAMERA_WEB_FRAMESIZE_QXGA
    bool "QXGA 2048x1536"

config CAMERA_WEB_FRAMESIZE_QSXGA
    bool "QSXGA 2560x1920 (OV5640 max)"

endchoice

config CAMERA_WEB_JPEG_QUALITY
    int "JPEG quality"
    default 10
    range 4 63
    help
        Smaller values produce higher quality and larger frames.

config CAMERA_WEB_FB_COUNT
    int "Camera framebuffer count"
    default 2
    range 1 3

config CAMERA_WEB_VFLIP
    bool "Vertical flip"
    default n

config CAMERA_WEB_HMIRROR
    bool "Horizontal mirror"
    default n

config CAMERA_WEB_HTTPD_STACK_SIZE
    int "HTTP server task stack size"
    default 8192
    range 4096 32768

endmenu
```

## esp32_s3_camera_webserver/sdkconfig.defaults
```kconfig
CONFIG_IDF_TARGET="esp32s3"
CONFIG_IDF_TARGET_ESP32S3=y
CONFIG_ESP_MAIN_TASK_STACK_SIZE=8192
CONFIG_FREERTOS_HZ=1000
CONFIG_SPIRAM=y
CONFIG_SPIRAM_MODE_OCT=y
CONFIG_ESP_DEFAULT_CPU_FREQ_MHZ_240=y
CONFIG_ESPTOOLPY_FLASHMODE_QIO=y
CONFIG_ESPTOOLPY_FLASHSIZE_8MB=y
CONFIG_ESPTOOLPY_FLASHSIZE="8MB"
CONFIG_PARTITION_TABLE_CUSTOM=y
CONFIG_PARTITION_TABLE_CUSTOM_FILENAME="partitions.csv"
CONFIG_PARTITION_TABLE_FILENAME="partitions.csv"
CONFIG_CAMERA_WEB_WIFI_SSID="YOUR_WIFI_SSID"
CONFIG_CAMERA_WEB_WIFI_PASSWORD="YOUR_WIFI_PASSWORD"
```

## esp_idf_template/sdkconfig.defaults
```kconfig
CONFIG_IDF_TARGET="esp32c3"
CONFIG_IDF_TARGET_ESP32C3=y
CONFIG_ESP_MAIN_TASK_STACK_SIZE=8192
CONFIG_FREERTOS_HZ=1000
```

## m5_sticks3/components/clock/Kconfig.projbuild
```kconfig
menu "M5-StickS3 Clock"
    config M5_CLOCK_TIMEZONE
        string "POSIX timezone"
        default "CST-8"
        help
            Passed to TZ/tzset. POSIX offsets have the opposite sign to UTC
            offsets: CST-8 means China Standard Time (UTC+8).

    config M5_CLOCK_TIMEZONE_LABEL
        string "Timezone display label"
        default "UTC+8"

    config M5_CLOCK_NTP_SERVER
        string "Primary NTP server"
        default "ntp.aliyun.com"

    config M5_CLOCK_NTP_SERVER_BACKUP
        string "Backup NTP server"
        default "pool.ntp.org"
endmenu
```

## m5_sticks3/components/connectivity/Kconfig.projbuild
```kconfig
menu "M5-StickS3 connectivity"
    config M5_CONNECTIVITY_CONSOLE_ENABLED
        bool "Enable local radio commands over USB Serial/JTAG console"
        depends on ESP_CONSOLE_USB_SERIAL_JTAG
        default y
        help
            Local CLI and API v1 JSON line input. Physical USB requests do not
            require the radio API token. No command echo or password history.
            Paused while USB CMSIS-DAP owns the internal PHY.
    config M5_CONNECTIVITY_WIFI_ENABLED
        bool "Enable Wi-Fi AP/STA and local HTTP API"
        default y
    config M5_CONNECTIVITY_BLE_ENABLED
        bool "Enable NimBLE GATT transport"
        depends on BT_NIMBLE_ENABLED
        default y
endmenu
```

## stepmotor_driver/sdkconfig.defaults
```kconfig
CONFIG_IDF_TARGET="esp32c3"
CONFIG_IDF_TARGET_ESP32C3=y
CONFIG_ESP_DEFAULT_CPU_FREQ_MHZ_160=y
CONFIG_ESPTOOLPY_FLASHSIZE_2MB=y
CONFIG_FREERTOS_HZ=1000
CONFIG_COMPILER_CXX_EXCEPTIONS=n
CONFIG_COMPILER_CXX_RTTI=n
CONFIG_ESP_CONSOLE_USB_SERIAL_JTAG=y
CONFIG_ESP_CONSOLE_SECONDARY_NONE=y
```

## template_project/config/sdkconfig.defaults
```kconfig
# Project Build Configuration

## Build Options
CONFIG_COMPILER_OPTIMIZATION_SIZE=y
CONFIG_COMPILER_OPTIMIZATION_ASSERTIONS_ENABLE=y

## Logging Configuration
CONFIG_LOG_DEFAULT_LEVEL=3
CONFIG_LOG_MAXIMUM_LEVEL=4

## Memory Configuration
CONFIG_ESP_SYSTEM_EVENT_QUEUE_SIZE=32

## FreeRTOS Configuration
CONFIG_FREERTOS_MAX_TASK_NAME_LEN=16
CONFIG_FREERTOS_TICK_RATE_HZ=100

## Component Config
CONFIG_COMPILER_CXX_EXCEPTIONS=y
```
